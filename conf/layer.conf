## conf/layer.conf
```bitbake
# We have a conf and classes directory, add to BBPATH
BBPATH .= ":${LAYERDIR}"

# We have recipes-* directories, add to BBFILES
BBFILES += "${LAYERDIR}/recipes-*/*/*.bb \
            ${LAYERDIR}/recipes-*/*/*.bbappend"

BBFILE_COLLECTIONS += "meta-sieltre-kernel"
BBFILE_PATTERN_meta-sieltre-kernel = "^${LAYERDIR}/"
BBFILE_PRIORITY_meta-sieltre-kernel = "6"

LAYERDEPENDS_meta-sieltre-kernel = "core"
LAYERSERIES_COMPAT_meta-sieltre-kernel = "walnascar"

# Fix fbcon mapping for iMX95 (Toradex default fbcon=map:3 is wrong for this SoC)
OSTREE_KERNEL_ARGS:remove = "fbcon=map:3"
OSTREE_KERNEL_ARGS:append = " fbcon=map:0"

CORE_IMAGE_EXTRA_INSTALL += " \
    i2c-tools \
    iproute2 \
    curl \
    nano \
"
```
